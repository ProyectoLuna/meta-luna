## conf/layer.conf
```bitbake
# We have a conf and classes directory, add to BBPATH
BBPATH .= ":${LAYERDIR}"

# We have recipes-* directories, add to BBFILES
BBFILES += "${LAYERDIR}/recipes-*/*/*.bb \
	${LAYERDIR}/recipes-*/*/*.bbappend"

BBFILE_COLLECTIONS += "luna"
BBFILE_PATTERN_luna = "^${LAYERDIR}/"
BBFILE_PRIORITY_luna = "6"

RF24 = " \
    rf24 \
    rf24-dev \
    rf24mesh \
    rf24mesh-dev \
    rf24network \
    rf24network-dev \
"
GATEWAY = " \
    gateway \
    server \
    daemon-comm \
    daemon-comm-dev \
"
UI = " \
    lunaui \
"

QT_LUNA = " \
     cute-logger \
     cute-logger-dev \
     qhttp \
     qhttp-dev \
"

#[CORE_MINIMAL]IMAGE_INSTALL_append = " ${RF24} ${GATEWAY} dropbear opkg ${UI}"
IMAGE_INSTALL_append = " ${RF24} ${GATEWAY} opkg ${UI} openssh-sftp-server ${QT_LUNA} hostapd"
EXTRA_IMAGE_FEATURES += "eclipse-debug"
```
